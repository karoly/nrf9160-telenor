## prj.conf
```kconfig
# General config
CONFIG_ASSERT=y

# LTE link control
CONFIG_LTE_LINK_CONTROL=y
CONFIG_LTE_AUTO_INIT_AND_CONNECT=y
CONFIG_LTE_PDP_CMD=y
CONFIG_LTE_PDP_CONTEXT="0,\"IP\",\"mda.ee\""

# Heap and stacks
CONFIG_HEAP_MEM_POOL_SIZE=16384
CONFIG_MAIN_STACK_SIZE=8192
CONFIG_SYSTEM_WORKQUEUE_STACK_SIZE=2048
CONFIG_HW_STACK_PROTECTION=y

# Disable native network stack to save some memory
CONFIG_NET_IPV4=n
CONFIG_NET_IPV6=n
CONFIG_NET_UDP=n
CONFIG_NET_TCP=n
CONFIG_NET_RX_STACK_SIZE=1024
CONFIG_NET_TX_STACK_SIZE=1024

# Uncomment the lines below to disable optimizations when debugging
# CONFIG_NO_OPTIMIZATIONS=y
# CONFIG_DEBUG=y


## All of the following options are necessary for FOTA:

CONFIG_APP_FIRMWARE_VERSION="1.0.0"

# Logging
CONFIG_LOG=y
CONFIG_LOG_STRDUP_MAX_STRING=64

# General config
CONFIG_REBOOT=y

# Network
CONFIG_NETWORKING=y

# BSD library
CONFIG_BSD_LIBRARY=y

# LTE link control
CONFIG_LTE_LINK_CONTROL=y

# Modem info
CONFIG_MODEM_INFO=y

# Extend CoAP retry timing to 10 seconds for LTE/LTE-M.
CONFIG_COAP_INIT_ACK_TIMEOUT_MS=10000

# The LwM2M RD server we use returns long options, specifically the client registration endpoint (== IMSI).
CONFIG_COAP_EXTENDED_OPTIONS_LEN=y
CONFIG_COAP_EXTENDED_OPTIONS_LEN_VALUE=32

# LwM2M
CONFIG_LWM2M=y
CONFIG_LWM2M_RW_JSON_SUPPORT=n
CONFIG_LWM2M_ENGINE_DEFAULT_LIFETIME=600
CONFIG_LWM2M_FIRMWARE_UPDATE_OBJ_SUPPORT=y
CONFIG_LWM2M_FIRMWARE_UPDATE_PULL_SUPPORT=y

# Firmware image
CONFIG_BOOTLOADER_MCUBOOT=y
CONFIG_IMG_MANAGER=y
CONFIG_MCUBOOT_IMG_MANAGER=y
CONFIG_IMG_ERASE_PROGRESSIVELY=y
CONFIG_FLASH=y
CONFIG_MPU_ALLOW_FLASH_WRITE=y
CONFIG_DFU_TARGET=y

# Firmware info
CONFIG_SPM_SECURE_SERVICES=y

# Add signing key relative to mcuboot folder
CONFIG_BOOT_SIGNATURE_KEY_FILE="../../../samples/fota/cert.pem"

# Immutable bootloader (secure boot)
CONFIG_SECURE_BOOT=y
CONFIG_SB_SIGNING_KEY_FILE="mcuboot-priv.pem"

# List of public keys stored in One Time Programmable memory, which the immutable bootloader uses to validate mcuboot signature.
# The public key for the signing key is automatically added, and must not be added to the public keys list.
CONFIG_SB_PUBLIC_KEY_FILES="mcuboot-pub2.pem"

## End FOTA options.
```

## mcuboot.conf
```kconfig
# Add signing key relative to mcuboot folder
CONFIG_BOOT_SIGNATURE_KEY_FILE="../../../samples/fota/cert.pem"

# Image version number for mcuboot. Increase by 1 when updating mcuboot over the air.
CONFIG_FW_INFO_FIRMWARE_VERSION=1
```

## src/main.c
```c
#include <zephyr.h>
#include <fw_info.h>
#include <logging/log.h>
#include <pm_config.h>
#include <secure_services.h>
#include <fw_info.h>

#include "fota.h"

LOG_MODULE_REGISTER(app_main, CONFIG_APP_LOG_LEVEL);

void main() {
	// static const mcuboot_slots_t *mcuboot_slots = (mcuboot_slots_t *)&(NRF_UICR_S->OTP[0]);
	LOG_INF("addr s0 %08X, s1 %08X", PM_S0_ADDRESS, PM_S1_ADDRESS);
	struct fw_info s0_info;
	struct fw_info s1_info;
	uint8_t mcuboot_version = 0;
	uint8_t slot = 0;
	
	int ret = spm_firmware_info(PM_S0_ADDRESS, &s0_info);
	if (ret != 0) {
		LOG_ERR("Could not find firmware info for s0 (err: %d)\n", ret);
	} else {
		if (s0_info.valid == CONFIG_FW_INFO_VALID_VAL) {
			mcuboot_version = (uint8_t) s0_info.version;
		}
		LOG_INF("mcuboot s0 version: %d valid: %d", s0_info.version, s0_info.valid == CONFIG_FW_INFO_VALID_VAL);
	}

	ret = spm_firmware_info(PM_S1_ADDRESS, &s1_info);
	if (ret != 0) {
		LOG_ERR("Could not find firmware info for s1 (err: %d)\n", ret);
	} else {
		if (s1_info.valid == CONFIG_FW_INFO_VALID_VAL && s1_info.version > mcuboot_version) {
			mcuboot_version = (uint8_t) s1_info.version;
			slot = 1;
		}
		LOG_INF("mcuboot s1 version: %d valid: %d", s1_info.version, s1_info.valid == CONFIG_FW_INFO_VALID_VAL);
	}
	
	//LOG_INF("mcuboot s1 version: %d valid: %d", s1_info.version, s1_info.valid == CONFIG_FW_INFO_VALID_VAL);
	//char version[32];
	//snprintk(version, sizeof(version), "boot%d-s%d/app%s", mcuboot_version, slot, CONFIG_APP_FIRMWARE_VERSION);
	fota_client_info client_info = {
		manufacturer: "Exploratory Engineering",
		model_number: "EE-FOTA-00",
		serial_number: "1",
		firmware_version: CONFIG_APP_FIRMWARE_VERSION,
	};

	// Initialize the application and run any self-tests before calling fota_init.
	// Otherwise, if initialization or self-tests fail after an update, reboot the system and the previous firmware image will be used.

	ret = fota_init(client_info);
	if (ret) {
		LOG_ERR("fota_init: %d", ret);
		return;
	}
}
```
